## config/west.yml
```yaml
manifest:
  remotes:
    - name: zmkfirmware
      url-base: https://github.com/zmkfirmware
    - name: hyhy-masa
      url-base: https://github.com/hyhy-masa
    - name: caksoylar  # <-- new entry
      url-base: https://github.com/caksoylar
    - name: pistation01
      url-base: https://github.com/pistation01
  projects:
    - name: zmk
      remote: hyhy-masa
      revision: 09ee8b42
      import: app/west.yml
    - name: zmk-pmw3610-driver
      remote: pistation01
      revision: adaptive-scroll
    - name: zmk-rgbled-widget
      remote: caksoylar
      revision: e9472d6c
  self:
    path: config
```
